## config/boards/shields/corned/Kconfig.defconfig
```kconfig
# Copyright (c) 2020 The ZMK Contributors
# SPDX-License-Identifier: MIT

if SHIELD_CORNED_DONGLE

config ZMK_KEYBOARD_NAME
	default "hh42 dongle"

config ZMK_SPLIT_BLE_ROLE_CENTRAL
	default y

config ZMK_USB
	default y

endif

if SHIELD_CORNED_LEFT || SHIELD_CORNED_RIGHT || SHIELD_CORNED_DONGLE

config ZMK_SPLIT
	default y

config ZMK_BLE
	default y

endif
```

## config/boards/shields/corned/Kconfig.shield
```kconfig
# Copyright (c) 2020 The ZMK Contributors
# SPDX-License-Identifier: MIT

config SHIELD_CORNED_LEFT
	def_bool $(shields_list_contains,corned_left)

config SHIELD_CORNED_RIGHT
	def_bool $(shields_list_contains,corned_right)

config SHIELD_CORNED_DONGLE
	def_bool $(shields_list_contains,corned_dongle)
```

## config/boards/shields/hh42/Kconfig.defconfig
```kconfig
# Copyright (c) 2020 The ZMK Contributors
# SPDX-License-Identifier: MIT

if SHIELD_HH42_DONGLE

config ZMK_KEYBOARD_NAME
	default "hh42 dongle"

config ZMK_SPLIT_BLE_ROLE_CENTRAL
	default y

config ZMK_USB
	default y

endif

if SHIELD_HH42_LEFT || SHIELD_HH42_RIGHT || SHIELD_HH42_DONGLE

config ZMK_SPLIT
	default y

config ZMK_BLE
	default y

endif
```

## config/boards/shields/hh42/Kconfig.shield
```kconfig
# Copyright (c) 2020 The ZMK Contributors
# SPDX-License-Identifier: MIT

config SHIELD_HH42_LEFT
	def_bool $(shields_list_contains,hh42_left)

config SHIELD_HH42_RIGHT
	def_bool $(shields_list_contains,hh42_right)

config SHIELD_HH42_DONGLE
	def_bool $(shields_list_contains,hh42_dongle)
```
